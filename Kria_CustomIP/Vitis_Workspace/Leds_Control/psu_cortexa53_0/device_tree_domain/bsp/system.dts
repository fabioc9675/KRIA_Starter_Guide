/*
 * CAUTION: This file is automatically generated by Xilinx.
 * Version: XSCT 2022.2
 * Today is: Thu Dec 28 10:48:24 2023
 */


&gem0 {
	local-mac-address = [00 0a 35 00 00 00];
};
&gem1 {
	local-mac-address = [00 0a 35 00 00 01];
};
